VERSION "XCP_DBC"

NS_ :

BS_:

BU_: Logger

BO_ 546 DTO: 64 Logger
  SG_ DTOPID M : 0|8@1+ (1,0) [0|255] ""  Logger
  SG_ SpeedSignal m0 : 8|32@1+ (0.0000000596,0) [0|255] "-"  Logger
  SG_ AccelerationSignal m0 : 40|16@1- (0.001953125,0) [-40.9609375|40.958984375] "m/s^2"  Logger
  SG_ VelocitySignal m0 : 56|16@1- (0.0625,0) [-250|250] "m/s^2"  Logger
  SG_ TemperatureSignal m0 : 72|16@1- (0.0625,0) [-25|25] "m/s^2"  Logger

CM_ SG_ 546 SpeedSignal "SpeedSignal | Description of SpeedSignal";
CM_ SG_ 546 AccelerationSignal "AccelerationSignal | Description of AccelerationSignal";
CM_ SG_ 546 VelocitySignal "VelocitySignal | Description of VelocitySignal";
CM_ SG_ 546 TemperatureSignal "TemperatureSignal | Description of TemperatureSignal";

BA_DEF_ "BusType" STRING ;
BA_DEF_ "ProtocolType" STRING ;
BA_DEF_ BO_ "VFrameFormat" ENUM "StandardCAN","ExtendedCAN","reserved","reserved","reserved","reserved","reserved","reserved","reserved","reserved","reserved","reserved","reserved","reserved","StandardCAN_FD","ExtendedCAN_FD";
BA_DEF_ SG_ "SignalIgnore" INT 0 1;
BA_DEF_DEF_ "BusType" "";
BA_DEF_DEF_ "ProtocolType" "";
BA_DEF_DEF_ "VFrameFormat" "StandardCAN_FD";
BA_DEF_DEF_ "SignalIgnore" 0;
BA_ "BusType" "CAN FD";
BA_ "SignalIgnore" SG_ 546 DTOPID 1;
