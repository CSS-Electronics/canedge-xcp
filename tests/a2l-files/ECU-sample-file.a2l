/* Sanitized A2L file by CSS Electronics */ ASAP2_VERSION 1 60
/* Version 1.60 */
/begin PROJECT CSS_SAMPLE_FILE
/* project identifier */ "XCP on CAN Sample File by CSS Electronics"
/* long identifier */
/begin HEADER "A2L for learning purposes" /* project specific comment */ VERSION "SAMPLE_FILE_XCP_ON_CAN_V1" PROJECT_NO SAMPLE_FILE_1 /end HEADER
/begin MODULE SampleECU
/* name */ ""
/* comment */
/begin MOD_COMMON "" /* comment */ BYTE_ORDER MSB_LAST ALIGNMENT_FLOAT64_IEEE 4 /end MOD_COMMON
/********** IF_DATA ASAP1B_XCP *************************/
/begin IF_DATA XCPplus 0x0102
 /begin PROTOCOL_LAYER 0x0102 /* XCP version */ 0x0019 0x0019 0x0019 0x0019 0x0019 0x0005 0x00C8 0x08 /* MAX_CTO */ 0x00FA /* MAX_DTO */ BYTE_ORDER_MSB_LAST ADDRESS_GRANULARITY_BYTE OPTIONAL_CMD GET_ID /* optional commands */ OPTIONAL_CMD SET_MTA OPTIONAL_CMD UPLOAD OPTIONAL_CMD BUILD_CHECKSUM OPTIONAL_CMD DOWNLOAD OPTIONAL_CMD SET_DAQ_PTR OPTIONAL_CMD WRITE_DAQ OPTIONAL_CMD WRITE_DAQ_MULTIPLE OPTIONAL_CMD SET_DAQ_LIST_MODE OPTIONAL_CMD GET_DAQ_LIST_MODE OPTIONAL_CMD START_STOP_DAQ_LIST OPTIONAL_CMD START_STOP_SYNCH OPTIONAL_CMD GET_DAQ_CLOCK OPTIONAL_CMD FREE_DAQ OPTIONAL_CMD ALLOC_DAQ OPTIONAL_CMD ALLOC_ODT OPTIONAL_CMD ALLOC_ODT_ENTRY OPTIONAL_CMD GET_SEED OPTIONAL_CMD UNLOCK /end PROTOCOL_LAYER
 /begin DAQ DYNAMIC /* DAQ config. type */ 0x0 /* MAX_DAQ */ 0x23 /* MAX_EVENT_CHANNEL */ 0x0 /* MIN_DAQ */ OPTIMISATION_TYPE_ODT_TYPE_32 ADDRESS_EXTENSION_FREE IDENTIFICATION_FIELD_TYPE_RELATIVE_WORD_ALIGNED GRANULARITY_ODT_ENTRY_SIZE_DAQ_BYTE 0xf6 /* MAX_ODT_ENTRY_SIZE_DAQ */ OVERLOAD_INDICATION_EVENT PRESCALER_SUPPORTED
  /begin TIMESTAMP_SUPPORTED 0x0001 /* TIMESTAMP_TICKS */ SIZE_DWORD UNIT_1US TIMESTAMP_FIXED /end TIMESTAMP_SUPPORTED
  /* xcp events */ /begin EVENT "c_MT_Default_Task_500us" "MT_500us" 9 DAQ 1 5 5 141 /end EVENT /begin EVENT "c_MT_Default_Task_1ms" "MT_1ms" 1 DAQ 1 1 6 140 /end EVENT /begin EVENT "c_MT_Default_Task_x1" "MT_x1" 2 DAQ 1 5 6 139 /end EVENT /begin EVENT "c_MT_Default_Task_x2" "MT_x2" 3 DAQ 1 1 7 138 /end EVENT /begin EVENT "c_MT_Default_Task_x4" "MT_x4" 4 DAQ 1 2 7 137 /end EVENT /begin EVENT "c_MT_Default_Task_x8" "MT_x8" 5 DAQ 1 4 7 136 /end EVENT /begin EVENT "c_MT_Default_Task_x24" "MT_x24" 6 DAQ 1 12 7 135 /end EVENT /begin EVENT "c_StartupAsyncDebug" "StAsyDbug" 7 DAQ 1 0 6 134 /end EVENT /begin EVENT "c_ProcessSwitchAsync" "PrcSwiAsy" 8 DAQ 1 0 0 133 /end EVENT /end DAQ
 /************************ start of CAN *********************/
 /begin XCP_ON_CAN 0x0102 /* XCP on CAN version */ CAN_ID_MASTER 0x40000111 /* CMD/STIM CAN-ID */ /* master -> slave */ CAN_ID_SLAVE 0x40000222 /* RES/ERR/EV/SERV/DAQ CAN-ID */ /* slave -> master */ /* Bit31= 1: extended identifier */ BAUDRATE 500000 /* BAUDRATE [Hz] */ SAMPLE_POINT 80 /* sample point */ /* [% complete bit time] */ BTL_CYCLES 80 /* BTL_CYCLES */ /* [slots per bit time] */ SJW 16 /* length synchr. segment */ /* [BTL_CYCLES] */
  /begin CAN_FD MAX_DLC 64 /* 8, 12, 16, 20, 24, 32, 48 or 64 */ CAN_FD_DATA_TRANSFER_BAUDRATE 2000000 /* BAUDRATE [Hz] */ SAMPLE_POINT 80 /* sample point receiver*/ /* [% complete bit time] */ BTL_CYCLES 20 /* BTL_CYCLES */ /* [slots per bit time] */ SJW 4 /* length synchr. segment */ /* [BTL_CYCLES] */ /end CAN_FD
  /begin PROTOCOL_LAYER 0x0102 /* XCP version */ 0x000A 0x000A 0x000A 0x000A 0x000A 0x0000 0x0020 0x40 /* MAX_CTO */ 0x0040 /* MAX_DTO */ BYTE_ORDER_MSB_LAST ADDRESS_GRANULARITY_BYTE OPTIONAL_CMD GET_ID /* optional commands */ OPTIONAL_CMD SET_MTA OPTIONAL_CMD UPLOAD OPTIONAL_CMD BUILD_CHECKSUM OPTIONAL_CMD DOWNLOAD OPTIONAL_CMD SET_DAQ_PTR OPTIONAL_CMD WRITE_DAQ OPTIONAL_CMD WRITE_DAQ_MULTIPLE OPTIONAL_CMD SET_DAQ_LIST_MODE OPTIONAL_CMD GET_DAQ_LIST_MODE OPTIONAL_CMD START_STOP_DAQ_LIST OPTIONAL_CMD START_STOP_SYNCH OPTIONAL_CMD GET_DAQ_CLOCK OPTIONAL_CMD FREE_DAQ OPTIONAL_CMD ALLOC_DAQ OPTIONAL_CMD ALLOC_ODT OPTIONAL_CMD ALLOC_ODT_ENTRY OPTIONAL_CMD GET_SEED OPTIONAL_CMD UNLOCK SEED_AND_KEY_EXTERNAL_FUNCTION "myseedandkeyfunct.dll" /end PROTOCOL_LAYER
  /begin DAQ DYNAMIC /* DAQ config. type */ 0x0 /* MAX_DAQ */ 0x23 /* MAX_EVENT_CHANNEL */ 0x0 /* MIN_DAQ */ OPTIMISATION_TYPE_DEFAULT ADDRESS_EXTENSION_FREE IDENTIFICATION_FIELD_TYPE_ABSOLUTE GRANULARITY_ODT_ENTRY_SIZE_DAQ_BYTE 0x3F /* MAX_ODT_ENTRY_SIZE_DAQ */ OVERLOAD_INDICATION_EVENT PRESCALER_SUPPORTED /* xcp events */ /begin EVENT "c_MT_Default_Task_x1" "MTTaskx1" 2 DAQ 1 5 6 139 /end EVENT /begin EVENT "c_MT_Default_Task_x2" "MTTaskx2" 3 DAQ 1 1 7 138 /end EVENT /begin EVENT "c_MT_Default_Task_x4" "MTTaskx4" 4 DAQ 1 2 7 137 /end EVENT /begin EVENT "c_MT_Default_Task_x8" "MTTaskx8" 5 DAQ 1 4 7 136 /end EVENT /begin EVENT "c_MT_Default_Task_x24" "MTTaskx24" 6 DAQ 1 12 7 135 /end EVENT /end DAQ
  TRANSPORT_LAYER_INSTANCE "CAN" /end XCP_ON_CAN
 /************************* end of CAN **********************/ /end IF_DATA
/********** MEASUREMENT ********************************/
/begin MEASUREMENT SpeedSignal "Description of SpeedSignal" ULONG COMPU_METHOD_1 1 0 0 255 ECU_ADDRESS 0xFACD01A2 SYMBOL_LINK "SYMBOL_LINK_1" 0
 /begin IF_DATA XCPplus 0x0102
  /begin DAQ_EVENT VARIABLE /begin AVAILABLE_EVENT_LIST EVENT 2 /end AVAILABLE_EVENT_LIST /begin DEFAULT_EVENT_LIST EVENT 2 /end DEFAULT_EVENT_LIST /end DAQ_EVENT
 /end IF_DATA
/end MEASUREMENT
/begin MEASUREMENT AccelerationSignal "Description of AccelerationSignal" SWORD COMPU_METHOD_2 1 0 -40.9609375 40.958984375 ECU_ADDRESS 0xFACD03A5 /end MEASUREMENT
/begin MEASUREMENT VelocitySignal "Description of VelocitySignal" SWORD COMPU_METHOD_3 1 0 -250 250 ECU_ADDRESS 0xFACA06A7 /end MEASUREMENT
/begin MEASUREMENT TemperatureSignal "Description of TemperatureSignal" SWORD COMPU_METHOD_3 1 0 -25 25 ECU_ADDRESS 0xFACD11B2
 /begin IF_DATA XCPplus 0x0102
  /begin DAQ_EVENT VARIABLE /begin AVAILABLE_EVENT_LIST EVENT 2 /end AVAILABLE_EVENT_LIST /begin DEFAULT_EVENT_LIST EVENT 2 /end DEFAULT_EVENT_LIST /end DAQ_EVENT
 /end IF_DATA
/end MEASUREMENT
/begin MEASUREMENT SignalQuality "Description of SignalQuality" UBYTE COMPU_METHOD_4 1 0 0 3 ECU_ADDRESS 0xFACD41C1
 /begin IF_DATA XCPplus 0x0102
  /begin DAQ_EVENT VARIABLE /begin AVAILABLE_EVENT_LIST EVENT 2 /end AVAILABLE_EVENT_LIST /begin DEFAULT_EVENT_LIST EVENT 2 /end DEFAULT_EVENT_LIST /end DAQ_EVENT
 /end IF_DATA
/end MEASUREMENT
/********** COMPU_METHOD *******************************/
/* complex formulas */
/begin COMPU_METHOD COMPU_METHOD_1 "no comment" RAT_FUNC "%42.21" "-" COEFFS 0 16777216 0 0 0 1 /end COMPU_METHOD
/begin COMPU_METHOD COMPU_METHOD_2 "no comment" RAT_FUNC "%42.21" "m/s^2" COEFFS 0 512 0 0 0 1 /end COMPU_METHOD
/begin COMPU_METHOD COMPU_METHOD_3 "no comment" RAT_FUNC "%42.21" "m/s^2" COEFFS 0 16 0 0 0 1 /end COMPU_METHOD
/begin COMPU_METHOD COMPU_METHOD_4 "" TAB_VERB "%.0" "" COMPU_TAB_REF ENUM_SignalQuality /end COMPU_METHOD
/* verbal formulas (enums) */
/begin COMPU_VTAB ENUM_SignalQuality "This table describes signal quality" TAB_VERB 4 0 "Inplausible" 1 "NotAvailable" 2 "Notreliable" 3 "Plausible" /end COMPU_VTAB
/********** RECORD_LAYOUT ******************************/
/********** GROUPS *************************************/
/end MODULE
/end PROJECT
